## soc/qcom/sail/Kconfig.soc
```kconfig
# Copyright The Zephyr Project Contributors
# SPDX-License-Identifier: Apache-2.0

config SOC_SERIES_SAIL
	bool

config SOC_SAIL_LEMANS
	bool
	select SOC_SERIES_SAIL
	select SOC_FAMILY_QUALCOMM

config SOC_SAIL_MONACO
	bool
	select SOC_SERIES_SAIL
	select SOC_FAMILY_QUALCOMM

config SOC_SERIES
	default "sail" if SOC_SERIES_SAIL

config SOC
	default "sail_lemans" if SOC_SAIL_LEMANS
	default "sail_monaco" if SOC_SAIL_MONACO
```

## soc/qti/Kconfig
```kconfig
# SPDX-License-Identifier: Apache-2.0

if SOC_FAMILY_QTI

rsource "*/Kconfig"

endif # SOC_FAMILY_QTI
```

## soc/qti/Kconfig.soc
```kconfig
# SPDX-License-Identifier: Apache-2.0

config SOC_FAMILY_QTI
	bool

config SOC_FAMILY
	default "qti" if SOC_FAMILY_QTI

rsource "*/Kconfig.soc"
```

## soc/qti/sail/Kconfig
```kconfig
# SPDX-License-Identifier: Apache-2.0

config SOC_SERIES_SAIL
	help
	  Qualcomm SA8797P SAIL safety-island Cortex-R52 (ARMv8-R AArch32).
```

## soc/qti/sail/Kconfig.defconfig
```kconfig
# SPDX-License-Identifier: Apache-2.0

if SOC_SERIES_SAIL

config NUM_IRQS
	default 480

config SYS_CLOCK_HW_CYCLES_PER_SEC
	default 19200000

endif # SOC_SERIES_SAIL
```

## soc/qti/sail/Kconfig.soc
```kconfig
# SPDX-License-Identifier: Apache-2.0

config SOC_SERIES_SAIL
	bool

config SOC_SAIL_R52
	bool
	select SOC_SERIES_SAIL
	select SOC_FAMILY_QTI
	select ARM
	select CPU_CORTEX_R52
	select CPU_HAS_ARM_MPU

config SOC_SERIES
	default "sail" if SOC_SERIES_SAIL

config SOC
	default "sail_r52" if SOC_SAIL_R52
```

## unoq/modules/charlieplex-display/dts/bindings/display/charlieplex-led-matrix.yaml
```yaml
# Copyright (c) 2026
# SPDX-License-Identifier: Apache-2.0

description: |
  Monochrome / grayscale LED matrix driven by charlieplexed GPIOs.

  N GPIO lines drive up to N*(N-1) LEDs. Each pixel is lit by driving one of
  the GPIO lines high and one low while all the other lines are held at high
  impedance (input / disconnected). A timer (counter device) ISR scans the
  pixels one at a time, fast enough that persistence of vision makes the whole
  matrix appear lit. Grayscale is produced by modulating, per pixel, the
  fraction of scan cycles in which that pixel is driven.

  The driver exposes the Zephyr display API. The framebuffer is laid out
  row-major (pixel index = y * width + x). The pixel-pairs property maps each
  framebuffer pixel to the pair of GPIO lines that light it.

  Example (a 2x2 matrix on 3 charlieplexed lines)::

      matrix: charlieplex-led-matrix {
          compatible = "charlieplex-led-matrix";
          gpios = <&gpioa 0 0>, <&gpioa 1 0>, <&gpioa 2 0>;
          counter = <&timer0>;
          refresh-frequency = <100>;
          width = <2>;
          height = <2>;
          grayscale-bits = <1>;
          /* (high << 8) | low, framebuffer order */
          pixel-pairs = <0x0001 0x0100 0x0002 0x0200>;
      };

  pixel-pairs[0] = 0x0001 -> pixel (0,0) lit by gpios[0] high, gpios[1] low.

compatible: "charlieplex-led-matrix"

include: display-controller.yaml

properties:
  gpios:
    type: phandle-array
    required: true
    description: |
      The bank of charlieplexed GPIO lines. The pixel-pairs indexes into this
      list. All lines must be on GPIO controllers that support configuring a
      pin as disconnected/high-impedance (the default for any standard Zephyr
      GPIO controller). The flags cell is accepted for completeness but the
      driver drives the lines actively high/low and tri-states the rest, so
      polarity flags are not used.

  counter:
    type: phandle
    required: true
    description: |
      Timer instance, used through the counter API as the scan time source.
      The driver sets a top value derived from refresh-frequency and the
      pixel count, and lights the next pixel on each top-value callback.

  refresh-frequency:
    type: int
    required: true
    description: |
      Target whole-matrix refresh rate in Hz (e.g. 100). The per-pixel scan
      tick is refresh-frequency * (number of grayscale sub-steps) * pixel
      count; the timer must be able to produce that tick rate.

  pixel-pairs:
    type: array
    required: true
    description: |
      One entry per pixel, in framebuffer (row-major) order; length must equal
      width * height. Each entry encodes the pair of GPIO lines that light that
      pixel as (high_index << 8) | low_index, where the indices are positions
      in the gpios list. The pixel is lit by driving gpios[high_index] high and
      gpios[low_index] low.

  grayscale-bits:
    type: int
    default: 1
    enum: [1, 2, 3, 4]
    description: |
      Number of brightness bits per pixel. 1 = monochrome (on/off). Higher
      values trade refresh headroom for brightness levels (2^bits levels). The
      Arduino UNO Q matrix uses 3. The display reports MONO01 either way; with
      grayscale-bits > 1 the per-pixel brightness set via display_set_brightness
      / non-zero framebuffer values selects the duty level.
```
