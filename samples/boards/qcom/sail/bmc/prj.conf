## CMakeLists.txt
```
# Copyright The Zephyr Project Contributors
# SPDX-License-Identifier: Apache-2.0
cmake_minimum_required(VERSION 3.28.0)
find_package(Zephyr REQUIRED HINTS $ENV{ZEPHYR_BASE})
project(sail_bmc)
target_sources(app PRIVATE src/main.c src/md.c src/platform.c src/sensors.c src/shell.c)
# The MD receiver and protocol decoder are SoC interfaces without a public header.
target_include_directories(app PRIVATE ${ZEPHYR_BASE}/soc/qcom/sail)
if(DEFINED BMC_BUILD_ID)
  target_compile_definitions(app PRIVATE BMC_BUILD_ID="${BMC_BUILD_ID}")
endif()
if(DEFINED BMC_IMAGE_ID)
  target_compile_definitions(app PRIVATE BMC_IMAGE_ID=${BMC_IMAGE_ID})
endif()
```

## Kconfig
```
# Copyright The Zephyr Project Contributors
# SPDX-License-Identifier: Apache-2.0

config SAMPLE_BMC_LOG_PERIOD_MS
	int "Status line period at boot in milliseconds (0: off)"
	default 1000

source "Kconfig.zephyr"
```

## prj.conf
```kconfig
# Copyright The Zephyr Project Contributors
# SPDX-License-Identifier: Apache-2.0
CONFIG_SAIL_START_WITHOUT_PCINIT=y
CONFIG_MBOX=y
CONFIG_SAIL_MD_RECEIVE=y
CONFIG_SAIL_RESET_SERVICE=y
CONFIG_SYS_CLOCK_EXISTS=y
CONFIG_ARM_ARCH_TIMER=y
CONFIG_SERIAL=y
CONFIG_CONSOLE=y
CONFIG_UART_CONSOLE=y
CONFIG_RAM_CONSOLE=n
CONFIG_PRINTK=y
CONFIG_LOG=n
CONFIG_SHELL=y
CONFIG_SHELL_BACKEND_SERIAL=y
CONFIG_SHELL_PROMPT_UART="bmc> "
CONFIG_SHELL_STACK_SIZE=4096
CONFIG_SHELL_CMDS_RESIZE=n
CONFIG_SHELL_VT100_COLORS=n
CONFIG_KERNEL_SHELL=n
CONFIG_DEVICE_SHELL=n
CONFIG_MAIN_STACK_SIZE=4096
CONFIG_CBPRINTF_FP_SUPPORT=n
```

## src/main.c
```c
/*
 * Copyright The Zephyr Project Contributors
 * SPDX-License-Identifier: Apache-2.0
 */

#include <stdarg.h>
#include <stdio.h>
#include <zephyr/kernel.h>
#include <zephyr/shell/shell.h>
#include <zephyr/shell/shell_uart.h>
#include <zephyr/sys/printk.h>
#include <soc.h>
#include "bmc.h"

#ifndef BMC_BUILD_ID
#define BMC_BUILD_ID "unversioned"
#endif

/* Image identifier the MD can read from the answer registers; 0 publishes nothing. */
#ifndef BMC_IMAGE_ID
#define BMC_IMAGE_ID 0
#endif
BUILD_ASSERT((BMC_IMAGE_ID >> 24) == 0, "BMC_IMAGE_ID must fit in 24 bits");

static atomic_t log_period_ms;
static atomic_t log_local;

const char *bmc_build_id(void)
{
	return BMC_BUILD_ID;
}

static const char *const thread_names[BMC_THREADS] = {"platform", "md", "log", "shell"};
static atomic_t thread_seen[BMC_THREADS];
static atomic_t thread_runs[BMC_THREADS];
static atomic_t thread_pinned[BMC_THREADS];

void bmc_cpu_mark(enum bmc_thread thread)
{
	unsigned int key = arch_irq_lock();

	atomic_or(&thread_seen[thread], BIT(arch_curr_cpu()->id));
	arch_irq_unlock(key);
	atomic_inc(&thread_runs[thread]);
}

void bmc_cpu_report(enum bmc_thread thread, struct bmc_thread_cpus *out)
{
	out->name = thread_names[thread];
	out->pinned = (uint32_t)atomic_get(&thread_pinned[thread]);
	out->seen = (uint32_t)atomic_get(&thread_seen[thread]);
	out->runs = (uint32_t)atomic_get(&thread_runs[thread]);
}

/*
 * Platform on CPU 0, application threads on CPU 1 when this image started it
 * (it stays in reset when the fuses pair it into lockstep).
 */
uint32_t bmc_app_cpu(void)
{
#if defined(CONFIG_SMP)
	return sail_core_status(0U, 1U) == 0 ? 1U : 0U;
#else
	return 0U;
#endif
}

/* Pin a thread that is not running yet, or that is blocked. */
void bmc_cpu_place(enum bmc_thread thread, struct k_thread *tid)
{
	uint32_t cpu = thread == BMC_THREAD_PLATFORM ? 0U : bmc_app_cpu();

#if defined(CONFIG_SMP)
	if (k_thread_cpu_pin(tid, (int)cpu) != 0) {
		return;
	}
#else
	ARG_UNUSED(tid);
#endif
	atomic_set(&thread_pinned[thread], (atomic_val_t)BIT(cpu));
}

/*
 * Image word flags: bit 24 core 1 started, bit 25 the MD and log threads ran
 * and only on CPU 1, bit 26 the platform thread ran and only on CPU 0.
 */
uint32_t bmc_image_word(void)
{
	uint32_t flags = 0U;

	if (BMC_IMAGE_ID == 0) {
		return 0U;
	}
	if (bmc_app_cpu() == 1U) {
		flags |= BIT(24);
	}
	if (atomic_get(&thread_seen[BMC_THREAD_MD]) == BIT(1) &&
	    atomic_get(&thread_seen[BMC_THREAD_LOG]) == BIT(1)) {
		flags |= BIT(25);
	}
	if (atomic_get(&thread_seen[BMC_THREAD_PLATFORM]) == BIT(0)) {
		flags |= BIT(26);
	}
	return (uint32_t)BMC_IMAGE_ID | flags;
}

uint64_t bmc_uptime_ms(void)
{
	return (uint64_t)k_uptime_get();
}

void bmc_log_set(uint32_t period_ms)
{
	atomic_set(&log_period_ms, (atomic_val_t)period_ms);
}

uint32_t bmc_log_period(void)
{
	return (uint32_t)atomic_get(&log_period_ms);
}

void bmc_log_set_local(bool local)
{
	atomic_set(&log_local, local ? 1 : 0);
}

bool bmc_log_local(void)
{
	return atomic_get(&log_local) != 0;
}

/* Asynchronous output goes through the shell so the prompt is redrawn after it. */
void bmc_out(const char *fmt, ...)
{
	const struct shell *sh = shell_backend_uart_get_ptr();
	va_list ap;

	va_start(ap, fmt);
	if (sh != NULL && sh->ctx->state == SHELL_STATE_ACTIVE) {
		shell_vfprintf(sh, SHELL_NORMAL, fmt, ap);
	} else {
		vprintk(fmt, ap);
	}
	va_end(ap);
}

/*
 * One machine-parseable line: key=value pairs, temperatures in deci-degrees C.
 * In local mode nothing outside SAIL is read.
 */
static void log_line(void)
{
	char line[256];
	struct bmc_md_status md;
	uint64_t now = bmc_uptime_ms();
	size_t len;

	bmc_md_status_get(&md);
	len = snprintf(line, sizeof(line), "BMC t=%llu md=%s notices=%u last=0x%08x hb=%s", now,
		       bmc_md_state_name(md.state), md.notices, md.last_word,
		       md.hb_configured ? "on" : "off");
	if (md.hb_configured && len < sizeof(line)) {
		len += snprintf(line + len, sizeof(line) - len, " hb_val=0x%08x hb_age_ms=%llu",
				md.hb_value, now - md.hb_changed_ms);
	}
	if (len < sizeof(line)) {
		len += snprintf(line + len, sizeof(line) - len, " wdt=%s",
				md.wdt_enabled ? (md.wdt_armed ? "armed" : "idle") : "off");
	}
	if (!bmc_log_local()) {
		struct bmc_sensor s[BMC_SENSORS_MAX];
		size_t n = bmc_sensors_read(s, ARRAY_SIZE(s));

		for (size_t i = 0; i < n && len < sizeof(line); i++) {
			if (s[i].valid) {
				len += snprintf(line + len, sizeof(line) - len, " %s=%d", s[i].name,
						s[i].value);
			} else {
				len += snprintf(line + len, sizeof(line) - len, " %s=na",
						s[i].name);
			}
		}
	}
	bmc_out("%s\n", line);
}

static void log_thread(void *p1, void *p2, void *p3)
{
	ARG_UNUSED(p1);
	ARG_UNUSED(p2);
	ARG_UNUSED(p3);

	for (;;) {
		uint32_t period = bmc_log_period();

		bmc_cpu_mark(BMC_THREAD_LOG);
		if (period != 0U) {
			log_line();
			k_msleep(period);
		} else {
			k_msleep(100);
		}
	}
}

K_THREAD_STACK_DEFINE(log_stack, 4096);

/* The shell starts its thread itself; pin it once it blocks for input. */
static void place_shell(void)
{
	const struct shell *sh = shell_backend_uart_get_ptr();

	for (int i = 0; i < 100; i++) {
		if (sh == NULL || sh->ctx->tid == NULL) {
			return;
		}
		bmc_cpu_place(BMC_THREAD_SHELL, sh->thread);
		if (atomic_get(&thread_pinned[BMC_THREAD_SHELL]) != 0) {
			return;
		}
		k_msleep(10);
	}
}

int main(void)
{
	static struct k_thread log_tid;
	int rc;

	printk("\nSAIL BMC %s chip=0x%04x boot_mode=0x%x boot_status=%d app_cpu=%u\n",
	       bmc_build_id(), sail_chip_id_get(), (unsigned int)sail_boot_mode_get(),
	       sail_boot_status(), bmc_app_cpu());
	rc = bmc_platform_start();
	printk("SAIL BMC platform rc=%d\n", rc);
	bmc_md_start();
	bmc_log_set(CONFIG_SAMPLE_BMC_LOG_PERIOD_MS);
	k_thread_create(&log_tid, log_stack, K_THREAD_STACK_SIZEOF(log_stack), log_thread, NULL,
			NULL, NULL, K_PRIO_PREEMPT(4), 0, K_FOREVER);
	k_thread_name_set(&log_tid, "log");
	bmc_cpu_place(BMC_THREAD_LOG, &log_tid);
	k_thread_start(&log_tid);
	place_shell();
	return 0;
}
```

## src/bmc.h
```c
/*
 * Copyright The Zephyr Project Contributors
 * SPDX-License-Identifier: Apache-2.0
 */
#ifndef BMC_H_
#define BMC_H_

#include <stdbool.h>
#include <stddef.h>
#include <stdint.h>

#define BMC_NOTICE_HISTORY 16U

struct bmc_notice {
	uint64_t at_ms;
	uint32_t word;
	uint8_t channel;
};

enum bmc_md_state {
	BMC_MD_UNKNOWN,
	BMC_MD_BOOTING,
	BMC_MD_RUNNING,
	BMC_MD_HUNG,
	BMC_MD_RESETTING,
	BMC_MD_SHUTDOWN,
};

struct bmc_md_status {
	enum bmc_md_state state;
	uint32_t notices;
	uint32_t last_word;
	uint64_t last_notice_ms;
	bool hb_configured;
	uint32_t hb_addr;
	uint32_t hb_value;
	uint64_t hb_changed_ms;
	uint32_t hb_changes;
	bool wdt_enabled;
	bool wdt_reset;
	bool wdt_armed;
	uint32_t wdt_timeout_s;
	uint32_t wdt_fired;
	uint32_t resets_requested;
	int last_reset_result;
	uint32_t dropped;
	bool retired;
};

const char *bmc_md_state_name(enum bmc_md_state state);
void bmc_md_start(void);
void bmc_md_notice(uint32_t word, uint32_t channel);
void bmc_md_retire(void);
int bmc_read32(uint32_t sail_addr, uint32_t *value);
void bmc_md_status_get(struct bmc_md_status *status);
size_t bmc_md_history(struct bmc_notice *out, size_t max);
void bmc_md_heartbeat_set(uint32_t addr);
void bmc_md_wdt_set(bool enabled, uint32_t timeout_s, bool reset);
int bmc_md_reset(const char *how);

#define BMC_SENSORS_MAX 16U

struct bmc_sensor {
	char name[12];
	int32_t value;
	char unit[4];
	bool valid;
};

size_t bmc_sensors_read(struct bmc_sensor *out, size_t max);

uint64_t bmc_uptime_ms(void);
void bmc_log_set(uint32_t period_ms);
uint32_t bmc_log_period(void);
const char *bmc_build_id(void);
void bmc_out(const char *fmt, ...);
bool bmc_readable(uint32_t sail_addr);
bool bmc_log_local(void);
int bmc_platform_start(void);
int bmc_platform_status(void);
uint32_t bmc_image_word(void);
void bmc_log_set_local(bool local);

#endif
```

## src/md.c
```c
/*
 * Copyright The Zephyr Project Contributors
 * SPDX-License-Identifier: Apache-2.0
 */

/*
 * Main-domain (MD) monitor: records the MD notices the platform thread hands
 * over, tracks a heartbeat word that software on the MD advances, and in
 * watchdog mode reports (and optionally resets) an MD whose heartbeat stops.
 */

#include <errno.h>
#include <string.h>
#include <zephyr/kernel.h>
#include <zephyr/spinlock.h>
#include <zephyr/arch/cpu.h>
#include <soc.h>
#include "md_protocol.h"
#include "bmc.h"

#define MD_POLL_MS 10
#define HB_POLL_MS 100
/* MD physical addresses are reached from SAIL at MD + 0xc0000000. */
#define MD_ALIAS   0xc0000000U
#define SAIL_LOCAL 0xf0000000U

/*
 * Blocks SAIL has read on Lemans (IQ-9075 EVK) without a fault. Others,
 * including the main-domain TLMM, APSS watchdog and MPM, and parts of
 * SAILSS_PWR_CTRL, take a synchronous external abort, which halts SAIL. No
 * block is listed for other chips.
 */
#define CHIP_LEMANS 0x6019U

static const struct {
	uint32_t start, end;
} readable[] = {
	{0xcc251000U, 0xcc253000U}, /* MD TSENS2/3 TM */
	{0xcc263000U, 0xcc264000U}, /* MD TSENS0 TM */
	{0xcc265000U, 0xcc266000U}, /* MD TSENS1 TM */
	{0xf0100000U, 0xf0144000U}, /* SAIL TLMM pad configuration */
	{0xf0305000U, 0xf0306000U}, /* SAIL/MD mailbox status words */
	{0xf1000000U, 0xf100003cU}, /* SAILSS_PWR_CTRL, first 15 words */
	{0xf1110000U, 0xf1120000U}, /* SAILSS_CC */
	{0xf1988000U, 0xf198c000U}, /* QUP SE2 (console) */
};

bool bmc_readable(uint32_t sail_addr)
{
	if (sail_chip_id_get() != CHIP_LEMANS) {
		return false;
	}
	for (size_t i = 0; i < ARRAY_SIZE(readable); i++) {
		if (sail_addr >= readable[i].start && sail_addr < readable[i].end) {
			return true;
		}
	}
	return false;
}

struct notice_msg {
	uint64_t at_ms;
	uint32_t word;
	uint32_t channel;
};

K_MSGQ_DEFINE(notice_queue, sizeof(struct notice_msg), BMC_NOTICE_HISTORY, 8);
static atomic_t dropped;

/* MD reads stop for good once a reset or shutdown is claimed: the MD may be gone. */
static struct k_spinlock io_lock;
static bool md_gone;

int bmc_read32(uint32_t sail_addr, uint32_t *value)
{
	k_spinlock_key_t key;
	int rc = 0;

	if (sail_addr >= SAIL_LOCAL) {
		*value = sys_read32(sail_addr);
		return 0;
	}
	key = k_spin_lock(&io_lock);
	if (md_gone) {
		rc = -ESHUTDOWN;
	} else {
		*value = sys_read32(sail_addr);
	}
	k_spin_unlock(&io_lock, key);
	return rc;
}

/* Called by the coordinator with its lock held: must not block. */
void bmc_md_retire(void)
{
	k_spinlock_key_t key = k_spin_lock(&io_lock);

	md_gone = true;
	k_spin_unlock(&io_lock, key);
}

void bmc_md_notice(uint32_t word, uint32_t channel)
{
	struct notice_msg m = {.at_ms = bmc_uptime_ms(), .word = word, .channel = channel};

	if (k_msgq_put(&notice_queue, &m, K_NO_WAIT) != 0) {
		atomic_inc(&dropped);
	}
}

static struct k_spinlock lock;
static struct bmc_md_status st;
static struct bmc_notice history[BMC_NOTICE_HISTORY];
static uint32_t history_next;

const char *bmc_md_state_name(enum bmc_md_state state)
{
	switch (state) {
	case BMC_MD_BOOTING:
		return "booting";
	case BMC_MD_RUNNING:
		return "running";
	case BMC_MD_HUNG:
		return "hung";
	case BMC_MD_RESETTING:
		return "resetting";
	case BMC_MD_SHUTDOWN:
		return "shutdown";
	default:
		return "unknown";
	}
}

static enum bmc_md_state state_after(enum bmc_md_state cur, enum sail_md_command cmd)
{
	switch (cmd) {
	case SAIL_MD_COMMAND_DDR_READY:
	case SAIL_MD_COMMAND_CC020000:
	case SAIL_MD_COMMAND_CC030000:
	case SAIL_MD_COMMAND_CC040000:
	case SAIL_MD_COMMAND_CC050000:
	case SAIL_MD_COMMAND_XBL_BOOT_SUCCESS:
	case SAIL_MD_COMMAND_SECURE_BOOT_NOTICE:
	case SAIL_MD_COMMAND_HYP_BOOT_NOTICE:
		return BMC_MD_BOOTING;
	case SAIL_MD_COMMAND_SOC_HR:
	case SAIL_MD_COMMAND_WARM_RESET:
		return BMC_MD_RESETTING;
	case SAIL_MD_COMMAND_GRACEFUL_SHUTDOWN:
		return BMC_MD_SHUTDOWN;
	default:
		return cur;
	}
}

static void record_notice(const struct notice_msg *ev)
{
	uint32_t word = ev->word;
	uint64_t now = ev->at_ms;
	enum sail_md_command cmd = sail_md_command_decode(word);
	k_spinlock_key_t key = k_spin_lock(&lock);

	history[history_next % BMC_NOTICE_HISTORY] = (struct bmc_notice){
		.at_ms = now, .word = word, .channel = (uint8_t)ev->channel};
	history_next++;
	st.notices++;
	st.last_word = word;
	st.last_notice_ms = now;
	st.state = state_after(st.state, cmd);
	if (st.state == BMC_MD_RESETTING || st.state == BMC_MD_SHUTDOWN) {
		/* An orderly reset or shutdown is not a hang. */
		st.wdt_armed = false;
	}
	k_spin_unlock(&lock, key);
	bmc_out("BMC notice t=%llu ch=%u word=0x%08x\n", now, ev->channel, word);
}

static void heartbeat_poll(uint64_t now)
{
	bool fire = false, do_reset = false;
	uint32_t timeout_s = 0U, age_ms = 0U;
	k_spinlock_key_t key = k_spin_lock(&lock);

	uint32_t v;

	if (st.hb_configured && bmc_read32(st.hb_addr + MD_ALIAS, &v) == 0) {
		if (v != st.hb_value) {
			st.hb_value = v;
			st.hb_changed_ms = now;
			st.hb_changes++;
			if (st.hb_changes > 1U) {
				st.state = BMC_MD_RUNNING;
				st.wdt_armed = st.wdt_enabled;
			}
		} else if (st.wdt_enabled && st.wdt_armed &&
			   now - st.hb_changed_ms >= (uint64_t)st.wdt_timeout_s * 1000U) {
			st.wdt_armed = false;
			st.wdt_fired++;
			st.state = BMC_MD_HUNG;
			fire = true;
			do_reset = st.wdt_reset;
			timeout_s = st.wdt_timeout_s;
			age_ms = (uint32_t)(now - st.hb_changed_ms);
		}
	}
	k_spin_unlock(&lock, key);

	if (fire) {
		bmc_out("BMC MDWDT t=%llu heartbeat lost age_ms=%u timeout_s=%u action=%s\n", now,
		       age_ms, timeout_s, do_reset ? "reset" : "log");
		if (do_reset) {
			int rc = bmc_md_reset("auto");

			bmc_out("BMC MDWDT reset rc=%d\n", rc);
		}
	}
}

static void md_thread(void *a, void *b, void *c)
{
	struct notice_msg ev;
	uint32_t ticks = 0U;

	ARG_UNUSED(a);
	ARG_UNUSED(b);
	ARG_UNUSED(c);

	for (;;) {
		while (k_msgq_get(&notice_queue, &ev, K_NO_WAIT) == 0) {
			record_notice(&ev);
		}
		if (++ticks >= HB_POLL_MS / MD_POLL_MS) {
			ticks = 0U;
			heartbeat_poll(bmc_uptime_ms());
		}
		k_msleep(MD_POLL_MS);
	}
}

K_THREAD_STACK_DEFINE(md_stack, 2048);
static struct k_thread md_tid;

void bmc_md_start(void)
{
	k_thread_create(&md_tid, md_stack, K_THREAD_STACK_SIZEOF(md_stack), md_thread, NULL,
			NULL, NULL, K_PRIO_PREEMPT(2), 0, K_NO_WAIT);
	k_thread_name_set(&md_tid, "md");
}

void bmc_md_status_get(struct bmc_md_status *out)
{
	k_spinlock_key_t key = k_spin_lock(&lock);

	*out = st;
	k_spin_unlock(&lock, key);
	out->dropped = (uint32_t)atomic_get(&dropped);
	key = k_spin_lock(&io_lock);
	out->retired = md_gone;
	k_spin_unlock(&io_lock, key);
}

size_t bmc_md_history(struct bmc_notice *out, size_t max)
{
	k_spinlock_key_t key = k_spin_lock(&lock);
	uint32_t count = MIN(history_next, BMC_NOTICE_HISTORY);
	uint32_t first = history_next - count;
	size_t n = 0;

	for (uint32_t i = 0U; i < count && n < max; i++) {
		out[n++] = history[(first + i) % BMC_NOTICE_HISTORY];
	}
	k_spin_unlock(&lock, key);
	return n;
}

void bmc_md_heartbeat_set(uint32_t addr)
{
	k_spinlock_key_t key = k_spin_lock(&lock);

	st.hb_configured = addr != 0U;
	st.hb_addr = addr;
	st.hb_changes = 0U;
	st.hb_changed_ms = bmc_uptime_ms();
	st.wdt_armed = false;
	if (st.hb_configured && bmc_read32(addr + MD_ALIAS, &st.hb_value) != 0) {
		st.hb_value = 0U;
	}
	k_spin_unlock(&lock, key);
}

void bmc_md_wdt_set(bool enabled, uint32_t timeout_s, bool reset)
{
	k_spinlock_key_t key = k_spin_lock(&lock);

	st.wdt_enabled = enabled;
	st.wdt_timeout_s = timeout_s;
	st.wdt_reset = reset;
	/* Armed by the next heartbeat change, never by a stale value. */
	st.wdt_armed = false;
	k_spin_unlock(&lock, key);
}

/*
 * No reset path is available to SAIL on the IQ-9075 EVK: it has no SAIL PMIC,
 * and the main domain's MPM PS_HOLD register gives SAIL an external abort.
 */
int bmc_md_reset(const char *how)
{
	k_spinlock_key_t key = k_spin_lock(&lock);

	st.resets_requested++;
	st.last_reset_result = -ENOTSUP;
	k_spin_unlock(&lock, key);
	bmc_out("BMC md reset t=%llu reason=%s: no main-domain reset path on this board\n",
		bmc_uptime_ms(), how);
	return -ENOTSUP;
}
```

## src/platform.c
```c
/*
 * Copyright The Zephyr Project Contributors
 * SPDX-License-Identifier: Apache-2.0
 */

/*
 * Platform thread: runs the main-domain reset coordinator, hands every notice
 * it consumes to the MD monitor, and publishes the image word in the answer
 * registers for the MD to read.
 */

#include <errno.h>
#include <zephyr/kernel.h>
#include <zephyr/sys/printk.h>
#include <soc.h>
#include "bmc.h"

#define POLL_MS 2
#define XBL_BOOT_SUCCESS 0xcb000003U
#define SDI_NOTICE       0xcd0a0000U
/* The MD polls for an answer for up to 1 s; keep the image word off it far longer. */
#define ANSWER_HOLD_MS 12000

static atomic_t coordinator_rc = ATOMIC_INIT(-EINPROGRESS);

int bmc_platform_status(void)
{
	return (int)atomic_get(&coordinator_rc);
}

static int retire(void *context)
{
	ARG_UNUSED(context);
	bmc_md_retire();
	return 0;
}

static void platform_thread(void *p1, void *p2, void *p3)
{
	struct sail_reset_service_notice notice;
	uint64_t seen = 0U;
	int64_t publish_at = -1;
	uint32_t published = 0U;
	int rc;

	ARG_UNUSED(p1);
	ARG_UNUSED(p2);
	ARG_UNUSED(p3);

	rc = sail_reset_service_start(retire, NULL);
	atomic_set(&coordinator_rc, rc);
	while (rc >= 0) {
		rc = sail_reset_service_poll();
		if (rc != 0 && sail_reset_service_notice_get(&notice) == 0 &&
		    notice.sequence != seen) {
			seen = notice.sequence;
			bmc_md_notice(notice.word, notice.channel);
			if (notice.word == XBL_BOOT_SUCCESS) {
				publish_at = k_uptime_get();
			} else if (notice.word == SDI_NOTICE) {
				publish_at = k_uptime_get() + ANSWER_HOLD_MS;
			}
		}
		if (rc < 0) {
			break;
		}
		if (publish_at >= 0 && k_uptime_get() >= publish_at) {
			uint32_t word = bmc_image_word();

			if (word != 0U && word != published &&
			    sail_reset_service_publish(word) == 0) {
				published = word;
			}
		}
		if (rc == 0) {
			k_msleep(POLL_MS);
		}
	}
	atomic_set(&coordinator_rc, rc);
	/* -ESHUTDOWN: the reset or shutdown was answered and the coordinator completed. */
	bmc_out("BMC platform t=%llu coordinator %s rc=%d\n", bmc_uptime_ms(),
		rc == -ESHUTDOWN ? "complete" : "stopped", rc);
}

K_THREAD_STACK_DEFINE(platform_stack, 4096);

int bmc_platform_start(void)
{
	static struct k_thread thread;

	if (sail_boot_mode_get() != SAIL_BOOT_PCINIT_DEFERRED) {
		return -EPERM;
	}
	k_thread_create(&thread, platform_stack, K_THREAD_STACK_SIZEOF(platform_stack),
			platform_thread, NULL, NULL, NULL, K_PRIO_COOP(1), 0, K_FOREVER);
	k_thread_name_set(&thread, "platform");
#if defined(CONFIG_SMP)
	/* The coordinator requires a worker that stays on CPU 0. */
	(void)k_thread_cpu_pin(&thread, 0);
#endif
	k_thread_start(&thread);
	return 0;
}
```

## src/sensors.c
```c
/*
 * Copyright The Zephyr Project Contributors
 * SPDX-License-Identifier: Apache-2.0
 */

/* SoC temperatures from the main-domain TSENS controllers, read through the SAIL alias. */

#include <stdio.h>
#include <zephyr/kernel.h>
#include <zephyr/arch/cpu.h>
#include <zephyr/sys/util.h>
#include "bmc.h"

#define SN_STATUS(n)   (0xa0U + 4U * (n))
#define SN_VALID       BIT(21)
#define SN_LAST_TEMP   GENMASK(11, 0)

struct tsens {
	uint32_t tm;
	uint8_t sensors;
};

/* TM register blocks (SAIL view) and sensor counts. */
static const struct tsens controllers[] = {
	{0xcc263000U, 12U},
	{0xcc265000U, 12U},
	{0xcc251000U, 13U},
	{0xcc252000U, 13U},
};

size_t bmc_sensors_read(struct bmc_sensor *out, size_t max)
{
	size_t n = 0;

	for (size_t c = 0; c < ARRAY_SIZE(controllers) && n < max; c++) {
		int32_t hottest = INT32_MIN;
		uint32_t valid = 0U;

		for (uint8_t s = 0U; s < controllers[c].sensors; s++) {
			uint32_t v;
			int32_t deci;

			if (bmc_read32(controllers[c].tm + SN_STATUS(s), &v) != 0) {
				continue;
			}
			deci = sign_extend(FIELD_GET(SN_LAST_TEMP, v), 11);
			if ((v & SN_VALID) != 0U) {
				valid++;
				hottest = MAX(hottest, deci);
			}
		}
		snprintf(out[n].name, sizeof(out[n].name), "tsens%u", (unsigned int)c);
		out[n].valid = valid != 0U;
		out[n].value = valid != 0U ? hottest : 0;
		snprintf(out[n].unit, sizeof(out[n].unit), "dC");
		n++;
	}
	return n;
}
```

## src/shell.c
```c
/*
 * Copyright The Zephyr Project Contributors
 * SPDX-License-Identifier: Apache-2.0
 */

#include <stdlib.h>
#include <string.h>
#include <zephyr/kernel.h>
#include <zephyr/shell/shell.h>
#include <zephyr/arch/cpu.h>
#include <soc.h>
#include "bmc.h"

static int parse_u32(const struct shell *sh, const char *s, uint32_t *v)
{
	char *end;
	unsigned long x = strtoul(s, &end, 0);

	if (end == s || *end != '\0') {
		shell_error(sh, "bad number: %s", s);
		return -EINVAL;
	}
	*v = (uint32_t)x;
	return 0;
}

static int cmd_version(const struct shell *sh, size_t argc, char **argv)
{
	ARG_UNUSED(argc);
	ARG_UNUSED(argv);
	bmc_cpu_mark(BMC_THREAD_SHELL);
	shell_print(sh, "SAIL BMC %s chip=0x%04x boot_mode=0x%x boot_status=%d", bmc_build_id(),
		    sail_chip_id_get(), (unsigned int)sail_boot_mode_get(), sail_boot_status());
	return 0;
}

static int cmd_cpus(const struct shell *sh, size_t argc, char **argv)
{
	uint32_t mpidr;

	ARG_UNUSED(argc);
	ARG_UNUSED(argv);
	bmc_cpu_mark(BMC_THREAD_SHELL);
	__asm__ volatile("mrc p15, 0, %0, c0, c0, 5" : "=r"(mpidr));
	shell_print(sh, "shell on cpu=%u mpidr=0x%08x app_cpu=%u", arch_curr_cpu()->id, mpidr,
		    bmc_app_cpu());
#if defined(CONFIG_SMP)
	for (uint32_t c = 0U; c < 2U; c++) {
		shell_print(sh, "cluster%u core0=%d core1=%d", c, sail_core_status(c, 0U),
			    sail_core_status(c, 1U));
	}
#endif
	for (int t = 0; t < BMC_THREADS; t++) {
		struct bmc_thread_cpus r;

		bmc_cpu_report(t, &r);
		shell_print(sh, "thread %-8s pinned=0x%x ran_on=0x%x runs=%u", r.name, r.pinned,
			    r.seen, r.runs);
	}
	return 0;
}

static int cmd_md_status(const struct shell *sh, size_t argc, char **argv)
{
	struct bmc_md_status md;
	struct bmc_notice h[BMC_NOTICE_HISTORY];
	uint64_t now = bmc_uptime_ms();
	size_t n;

	ARG_UNUSED(argc);
	ARG_UNUSED(argv);
	bmc_md_status_get(&md);
	shell_print(sh, "uptime_ms=%llu md=%s notices=%u last=0x%08x last_age_ms=%llu", now,
		    bmc_md_state_name(md.state), md.notices, md.last_word,
		    md.notices != 0U ? now - md.last_notice_ms : 0U);
	shell_print(sh, "coordinator rc=%d md_access=%s dropped=%u", bmc_platform_status(),
		    md.retired ? "retired" : "on", md.dropped);
	if (md.hb_configured) {
		shell_print(sh, "heartbeat addr=0x%08x value=0x%08x changes=%u age_ms=%llu",
			    md.hb_addr, md.hb_value, md.hb_changes, now - md.hb_changed_ms);
	} else {
		shell_print(sh, "heartbeat off");
	}
	shell_print(sh, "wdt=%s timeout_s=%u action=%s fired=%u resets=%u last_reset_rc=%d",
		    md.wdt_enabled ? (md.wdt_armed ? "armed" : "idle") : "off", md.wdt_timeout_s,
		    md.wdt_reset ? "reset" : "log", md.wdt_fired, md.resets_requested,
		    md.last_reset_result);
	n = bmc_md_history(h, ARRAY_SIZE(h));
	for (size_t i = 0; i < n; i++) {
		shell_print(sh, "notice t=%llu ch=%u word=0x%08x", h[i].at_ms, h[i].channel,
			    h[i].word);
	}
	return 0;
}

static int cmd_md_hb(const struct shell *sh, size_t argc, char **argv)
{
	uint32_t addr = 0U;

	ARG_UNUSED(argc);
	if (strcmp(argv[1], "off") != 0 && parse_u32(sh, argv[1], &addr) != 0) {
		return -EINVAL;
	}
	if (addr != 0U && ((addr & 3U) != 0U || addr >= 0x40000000U ||
			   !bmc_readable(addr + 0xc0000000U))) {
		shell_error(sh, "heartbeat address must be an aligned MD address SAIL can read");
		return -EINVAL;
	}
	bmc_md_heartbeat_set(addr);
	shell_print(sh, "heartbeat %s 0x%08x", addr != 0U ? "on" : "off", addr);
	return 0;
}

static int cmd_md_wdt(const struct shell *sh, size_t argc, char **argv)
{
	uint32_t timeout = 10U;
	bool reset = false;

	if (strcmp(argv[1], "off") == 0) {
		bmc_md_wdt_set(false, 0U, false);
		shell_print(sh, "wdt off");
		return 0;
	}
	if (strcmp(argv[1], "on") != 0) {
		shell_error(sh, "usage: md wdt off | on [seconds] [reset]");
		return -EINVAL;
	}
	if (argc > 2 && parse_u32(sh, argv[2], &timeout) != 0) {
		return -EINVAL;
	}
	if (argc > 3) {
		if (strcmp(argv[3], "reset") != 0) {
			shell_error(sh, "unknown action: %s", argv[3]);
			return -EINVAL;
		}
		reset = true;
	}
	if (timeout == 0U || timeout > 3600U) {
		shell_error(sh, "timeout must be 1..3600 s");
		return -EINVAL;
	}
	bmc_md_wdt_set(true, timeout, reset);
	shell_print(sh, "wdt on timeout_s=%u action=%s (arms at the next heartbeat change)",
		    timeout, reset ? "reset" : "log");
	return 0;
}

static int cmd_md_reset(const struct shell *sh, size_t argc, char **argv)
{
	int rc;

	if (argc < 2 || strcmp(argv[1], "now") != 0) {
		shell_print(sh, "md reset now: reset the main domain (not on this board)");
		return -EINVAL;
	}
	rc = bmc_md_reset("shell");

	if (rc != 0) {
		shell_error(sh, "md reset failed: %d", rc);
	}
	return rc;
}

static int cmd_sensors(const struct shell *sh, size_t argc, char **argv)
{
	struct bmc_sensor s[BMC_SENSORS_MAX];
	size_t n = bmc_sensors_read(s, ARRAY_SIZE(s));

	ARG_UNUSED(argc);
	ARG_UNUSED(argv);
	if (n == 0U) {
		shell_print(sh, "no sensors described for chip 0x%04x", sail_chip_id_get());
	}
	for (size_t i = 0; i < n; i++) {
		if (s[i].valid) {
			shell_print(sh, "%-8s max %d.%d C", s[i].name, s[i].value / 10,
				    abs(s[i].value % 10));
		} else {
			shell_print(sh, "%-8s no valid sample", s[i].name);
		}
	}
	return 0;
}

static int cmd_log(const struct shell *sh, size_t argc, char **argv)
{
	uint32_t period = 1000U;

	if (strcmp(argv[1], "off") == 0) {
		bmc_log_set(0U);
	} else if (strcmp(argv[1], "on") == 0) {
		if (argc > 2 && parse_u32(sh, argv[2], &period) != 0) {
			return -EINVAL;
		}
		if (argc > 3 && strcmp(argv[3], "local") != 0) {
			shell_error(sh, "usage: log on [ms] [local]");
			return -EINVAL;
		}
		bmc_log_set_local(argc > 3);
		if (period < 100U) {
			shell_error(sh, "period must be at least 100 ms");
			return -EINVAL;
		}
		bmc_log_set(period);
	} else {
		shell_error(sh, "usage: log on [ms] [local] | off");
		return -EINVAL;
	}
	shell_print(sh, "log period_ms=%u local=%d", bmc_log_period(), bmc_log_local());
	return 0;
}

static int cmd_peek(const struct shell *sh, size_t argc, char **argv)
{
	uint32_t addr, count = 1U;

	if (parse_u32(sh, argv[1], &addr) != 0 ||
	    (argc > 2 && parse_u32(sh, argv[2], &count) != 0)) {
		return -EINVAL;
	}
	if ((addr & 3U) != 0U || count == 0U || count > 64U) {
		shell_error(sh, "aligned address, count 1..64");
		return -EINVAL;
	}
	for (uint32_t i = 0U; i < count; i++) {
		if (!bmc_readable(addr + 4U * i)) {
			shell_error(sh, "0x%08x is not in a block SAIL can read", addr + 4U * i);
			return -EPERM;
		}
	}
	for (uint32_t i = 0U; i < count; i++) {
		uint32_t v;
		int rc = bmc_read32(addr + 4U * i, &v);

		if (rc != 0) {
			shell_error(sh, "0x%08x: main domain reset or off (%d)", addr + 4U * i, rc);
			return rc;
		}
		shell_print(sh, "0x%08x: 0x%08x", addr + 4U * i, v);
	}
	return 0;
}

SHELL_STATIC_SUBCMD_SET_CREATE(md_cmds,
	SHELL_CMD(status, NULL, "Main-domain state, notices, heartbeat, watchdog", cmd_md_status),
	SHELL_CMD_ARG(hb, NULL, "<md-address|off> Heartbeat word written by the MD", cmd_md_hb,
		      2, 0),
	SHELL_CMD_ARG(wdt, NULL, "off | on [seconds] [reset]", cmd_md_wdt, 2, 2),
	SHELL_CMD_ARG(reset, NULL, "now: reset the main domain", cmd_md_reset, 1, 1),
	SHELL_SUBCMD_SET_END);

SHELL_CMD_REGISTER(md, &md_cmds, "Main domain", NULL);
SHELL_CMD_REGISTER(sensors, NULL, "SoC temperatures", cmd_sensors);
SHELL_CMD_ARG_REGISTER(log, NULL, "on [ms] [local] | off: periodic status line", cmd_log, 2, 2);
SHELL_CMD_ARG_REGISTER(peek, NULL, "<address> [count]: read device words", cmd_peek, 2, 1);
SHELL_CMD_REGISTER(version, NULL, "Build fingerprint", cmd_version);
SHELL_CMD_REGISTER(cpus, NULL, "Cores and where the threads run", cmd_cpus);
```
