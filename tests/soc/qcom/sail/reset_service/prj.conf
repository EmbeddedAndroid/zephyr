## CMakeLists.txt
```
# Copyright The Zephyr Project Contributors
# SPDX-License-Identifier: Apache-2.0
cmake_minimum_required(VERSION 3.28.0)
find_package(Zephyr COMPONENTS unittest REQUIRED HINTS $ENV{ZEPHYR_BASE})
project(sail_reset_service_model)

set(soc_dir "${ZEPHYR_BASE}/soc/qcom/sail")
# Keep the finite kernel/Device boundary model out of the Ztest runner headers.
add_library(reset_service_model OBJECT src/model.c)
target_link_libraries(reset_service_model PRIVATE test_interface)
target_include_directories(reset_service_model BEFORE PRIVATE
  stubs
  src
  "${CMAKE_CURRENT_SOURCE_DIR}/../models"
  "${soc_dir}"
  "${soc_dir}/include"
  "${soc_dir}/monaco"
  "${soc_dir}/lemans"
)
target_compile_definitions(reset_service_model PRIVATE
  SAIL_TEST_FIXTURE_DIR="${CMAKE_CURRENT_SOURCE_DIR}/../fixtures"
)
if(SAIL_TEST_LEMANS)
  target_compile_definitions(reset_service_model PRIVATE SAIL_TEST_LEMANS=1)
endif()
# Model CONFIG_SMP: the worker CPU and its pinning become observable.
if(SAIL_TEST_SMP)
  target_compile_definitions(reset_service_model PRIVATE SAIL_TEST_SMP=1)
endif()
target_sources(reset_service_model PRIVATE
  "${soc_dir}/reset_service.c"
  "${soc_dir}/md_receive.c"
  "${soc_dir}/md_protocol.c"
  "${soc_dir}/boot_mode.c"
  "${soc_dir}/monaco/reset_io.c"
  "${soc_dir}/chip.c"
  "${soc_dir}/platform.c"
  "${soc_dir}/lemans/prepare.c"
  "${CMAKE_CURRENT_SOURCE_DIR}/../models/sail_test_platform.c"
)
foreach(component
    board_policy clock cold_boot cpu_pll early_clock hbcu i2c i2c_boot
    i2c_profile md_bist md_publication monaco_policy pmic pmic_boot pmic_policy
    pmic_reset pmic_shutdown pmic_transaction post_pmic_clock reset_prepare timer)
  target_sources(reset_service_model PRIVATE "${soc_dir}/monaco/${component}.c")
endforeach()
target_sources(testbinary PRIVATE src/main.c $<TARGET_OBJECTS:reset_service_model>)
```

## prj.conf
```kconfig
# Copyright The Zephyr Project Contributors
# SPDX-License-Identifier: Apache-2.0
CONFIG_ZTEST=y
```

## src/main.c
```c
/*
 * Copyright The Zephyr Project Contributors
 * SPDX-License-Identifier: Apache-2.0
 */

#include <zephyr/ztest.h>

int sail_model_test(void);

void sail_check_failed(const char *file, int line, const char *expr)
{
	printk("\n    Check failed at %s:%d: %s\n", file, line, expr);
	ztest_test_fail();
}

ZTEST(sail_boot, test_component_model)
{
	zassert_equal(sail_model_test(), 0);
}

ZTEST_SUITE(sail_boot, NULL, NULL, NULL, NULL, NULL);
```

## src/api.h
```c
/*
 * Copyright The Zephyr Project Contributors
 * SPDX-License-Identifier: Apache-2.0
 */
#ifndef RESET_MODEL_API_H
#define RESET_MODEL_API_H
#include "sail_check.h"
#include <zephyr/toolchain.h>
#include <stdbool.h>
#include <stddef.h>
#include <stdint.h>
#include <string.h>
#include <errno.h>
#define CONFIG_USERSPACE 0
#define IS_ENABLED(x)    (x)
#define BIT(n)           (1U << (n))
#ifndef ARRAY_SIZE
#define ARRAY_SIZE(a) (sizeof(a) / sizeof((a)[0]))
#endif
#define K_NO_WAIT 0
extern unsigned int test_irq_depth;
extern bool test_isr;
#ifdef SAIL_TEST_SMP
#define CONFIG_SMP 1
struct k_thread {
	struct {
		uint32_t cpu_mask;
	} base;
};
typedef struct k_thread *k_tid_t;
struct _cpu {
	uint32_t id;
};
extern struct _cpu test_cpu;
static inline struct _cpu *arch_curr_cpu(void)
{
	return &test_cpu;
}
#else
typedef uintptr_t k_tid_t;
#endif
extern k_tid_t test_thread;
static inline bool k_is_in_isr(void)
{
	return test_isr;
}
static inline k_tid_t k_current_get(void)
{
	return test_thread;
}
static inline unsigned int irq_lock(void)
{
	unsigned int key = test_irq_depth;

	test_irq_depth++;
	return key;
}
static inline void irq_unlock(unsigned int key)
{
	test_irq_depth = key;
}
static inline bool arch_irq_unlocked(unsigned int key)
{
	return key == 0;
}
static inline unsigned int arch_irq_lock(void)
{
	return irq_lock();
}
static inline void arch_irq_unlock(unsigned int key)
{
	irq_unlock(key);
}
struct k_spinlock {
	unsigned int held;
};
typedef unsigned int k_spinlock_key_t;
/* The lock is modeled as a local IRQ lock; it must not be taken recursively. */
static inline k_spinlock_key_t k_spin_lock(struct k_spinlock *l)
{
	sail_check(!l->held);
	l->held = 1U;
	return irq_lock();
}
static inline void k_spin_unlock(struct k_spinlock *l, k_spinlock_key_t key)
{
	sail_check(l->held);
	l->held = 0U;
	irq_unlock(key);
}
struct device {
	bool ready;
};
static inline bool device_is_ready(const struct device *d)
{
	return d->ready;
}
struct k_msgq {
	char *data;
	uint32_t bytes, depth, used, head;
};
static inline void k_msgq_init(struct k_msgq *q, char *data, uint32_t bytes, uint32_t depth)
{
	*q = (struct k_msgq){data, bytes, depth, 0, 0};
}
static inline uint32_t k_msgq_num_used_get(const struct k_msgq *q)
{
	return q->used;
}
static inline int k_msgq_put(struct k_msgq *q, const void *data, int timeout)
{
	(void)timeout;
	if (q->used == q->depth) {
		return -ENOMSG;
	}
	memcpy(q->data + ((q->head + q->used) % q->depth) * q->bytes, data, q->bytes);
	q->used++;
	return 0;
}
static inline int k_msgq_get(struct k_msgq *q, void *data, int timeout)
{
	(void)timeout;
	if (!q->used) {
		return -ENOMSG;
	}
	memcpy(data, q->data + q->head * q->bytes, q->bytes);
	q->head = (q->head + 1) % q->depth;
	q->used--;
	return 0;
}
struct mbox_msg {
	const void *data;
	size_t size;
};
typedef void (*mbox_callback_t)(const struct device *, uint32_t, void *, struct mbox_msg *);
int mbox_register_callback(const struct device *device, uint32_t channel, mbox_callback_t callback,
			   void *context);
int mbox_set_enabled(const struct device *device, uint32_t channel, bool enabled);
int mbox_mtu_get(const struct device *device);
uint32_t mbox_max_channels_get(const struct device *device);
uint32_t sys_read32(uintptr_t address);
void sys_write32(uint32_t value, uintptr_t address);
void barrier_dsync_fence_full(void);
#endif
```
