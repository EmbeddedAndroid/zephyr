## boards/arduino/ventuno_q_sail/Kconfig.ventuno_q_sail
```kconfig
# Copyright The Zephyr Project Contributors
# SPDX-License-Identifier: Apache-2.0

config BOARD_VENTUNO_Q_SAIL
	select SOC_SAIL_MONACO
```

## boards/arduino/ventuno_q_sail/board.yml
```yaml
# Copyright The Zephyr Project Contributors
# SPDX-License-Identifier: Apache-2.0

board:
  name: ventuno_q_sail
  full_name: Arduino VENTUNO Q safety island
  vendor: arduino
  socs:
    - name: sail_monaco
```

## boards/arduino/ventuno_q_sail/ventuno_q_sail_sail_monaco_cluster1_defconfig
```kconfig
# Copyright The Zephyr Project Contributors
# SPDX-License-Identifier: Apache-2.0

CONFIG_ISR_STACK_SIZE=2048
CONFIG_MAIN_STACK_SIZE=2048
CONFIG_CONSOLE=y
CONFIG_RAM_CONSOLE=y
CONFIG_PRINTK=y
CONFIG_SERIAL=n
CONFIG_USE_SWITCH=y
CONFIG_SMP=y
CONFIG_MP_MAX_NUM_CPUS=2
CONFIG_SCHED_CPU_MASK=y
CONFIG_ARM_ARCH_TIMER=y
CONFIG_SAIL_SECONDARY_CLUSTER=y
```

## boards/qcom/lemans_evk_sail/Kconfig.lemans_evk_sail
```kconfig
# Copyright The Zephyr Project Contributors
# SPDX-License-Identifier: Apache-2.0

config BOARD_LEMANS_EVK_SAIL
	select SOC_SAIL_LEMANS
```

## boards/qcom/lemans_evk_sail/board.yml
```yaml
# Copyright The Zephyr Project Contributors
# SPDX-License-Identifier: Apache-2.0

board:
  name: lemans_evk_sail
  full_name: Qualcomm Lemans EVK safety island
  vendor: qcom
  socs:
    - name: sail_lemans
```

## boards/qcom/lemans_evk_sail/lemans_evk_sail_defconfig
```kconfig
# Copyright The Zephyr Project Contributors
# SPDX-License-Identifier: Apache-2.0

CONFIG_ISR_STACK_SIZE=2048
CONFIG_MAIN_STACK_SIZE=2048
CONFIG_CONSOLE=y
CONFIG_RAM_CONSOLE=y
CONFIG_PRINTK=y
CONFIG_SERIAL=n
CONFIG_SAIL_START_WITHOUT_PCINIT=y
```

## boards/qcom/lemans_evk_sail/lemans_evk_sail_sail_lemans_smp_defconfig
```kconfig
# Copyright The Zephyr Project Contributors
# SPDX-License-Identifier: Apache-2.0

CONFIG_ISR_STACK_SIZE=2048
CONFIG_MAIN_STACK_SIZE=2048
CONFIG_CONSOLE=y
CONFIG_RAM_CONSOLE=y
CONFIG_PRINTK=y
CONFIG_SERIAL=n
CONFIG_SAIL_START_WITHOUT_PCINIT=y
CONFIG_USE_SWITCH=y
CONFIG_SMP=y
CONFIG_MP_MAX_NUM_CPUS=2
CONFIG_SCHED_CPU_MASK=y
CONFIG_ARM_ARCH_TIMER=y
CONFIG_SAIL_SECONDARY_CLUSTER_ENTRY=0x080c0000
```

## boards/qti/sail_r52/Kconfig.sail_r52
```kconfig
# SPDX-License-Identifier: Apache-2.0

config BOARD_SAIL_R52
	select SOC_SAIL_R52
```

## boards/qti/sail_r52/board.yml
```yaml
board:
  name: sail_r52
  full_name: Qualcomm SA8797P SAIL R52 (Zephyr stub)
  vendor: qti
  socs:
    - name: sail_r52
```

## drivers/clock_control/Kconfig.qcom_sail
```kconfig
# Copyright The Zephyr Project Contributors
# SPDX-License-Identifier: Apache-2.0

config CLOCK_CONTROL_QCOM_SAIL_CC
	bool "Qualcomm SAIL clock controller driver"
	default y
	depends on DT_HAS_QCOM_SAIL_CC_ENABLED
	help
	  Enable the driver for the Qualcomm safety island (SAIL) clock
	  controller: branch clock gating and the serial engine root clocks.
```

## drivers/mbox/Kconfig.qcom_sail
```kconfig
# Copyright The Zephyr Project Contributors
# SPDX-License-Identifier: Apache-2.0

config MBOX_QCOM_SAIL_RX
	bool "Qualcomm SAIL receive mailbox"
	default y
	depends on DT_HAS_QCOM_SAIL_MBOX_RX_ENABLED
	help
	  Enable the receive mailbox for the two main-domain doorbells on the
	  Qualcomm Monaco SAIL. Each doorbell interrupt delivers a 4-byte
	  message read from the low bytes of four shared status registers.
	  Both channels stay disabled until a client registers a callback and
	  enables them. Sending and acknowledging messages are not supported.
```

## drivers/pinctrl/Kconfig.qcom_sail
```kconfig
# Copyright The Zephyr Project Contributors
# SPDX-License-Identifier: Apache-2.0

config PINCTRL_QCOM_SAIL_TLMM
	bool "Qualcomm SAIL TLMM pin controller driver"
	default y
	depends on DT_HAS_QCOM_SAIL_TLMM_ENABLED
	help
	  Enable the pin controller driver for the Qualcomm safety island
	  (SAIL) TLMM.
```

## drivers/serial/Kconfig.qcom_geni
```kconfig
# Copyright The Zephyr Project Contributors
# SPDX-License-Identifier: Apache-2.0

config UART_QCOM_GENI
	bool "Qualcomm GENI UART driver"
	default y
	depends on DT_HAS_QCOM_GENI_UART_ENABLED
	select SERIAL_HAS_DRIVER
	select PINCTRL
	select CLOCK_CONTROL
	help
	  Enable the polled UART driver for Qualcomm GENI serial engines.

config UART_QCOM_GENI_SE_FW
	bool "Load UART firmware into serial engines without firmware"
	depends on UART_QCOM_GENI
	help
	  Build a QUP serial engine firmware image into the driver and load
	  its UART protocol firmware when a serial engine reports no
	  firmware at initialization. Without this option such a serial
	  engine fails to initialize.

config UART_QCOM_GENI_SE_FW_FILE
	string "QUP serial engine firmware image"
	depends on UART_QCOM_GENI_SE_FW
	help
	  Path of the QUP firmware ELF image (the qupv3fw.elf format loaded
	  by Linux), absolute or relative to the application directory.
```

## dts/bindings/arm/qcom,sail-platform.yaml
```yaml
# Copyright The Zephyr Project Contributors
# SPDX-License-Identifier: Apache-2.0

description: |
  A board supported by a Qualcomm safety island (SAIL) image. The cold
  initialization reads the chip ID from the SAIL hardware version register
  and uses the one node whose qcom,chip-id matches; the image stops if none
  or several match. Board properties come only from this node: SAIL never
  probes for a PMIC.

  An optional "pmic" child describes a PMIC on the SAIL I2C bus that powers
  SAIL from its own supply, and the rails the cold initialization checks
  and sets up. Without it the cold initialization ends after the
  main-domain BIST handshake.

compatible: "qcom,sail-platform"

properties:
  qcom,chip-id:
    type: int
    required: true
    description: Chip ID, bits 31:16 of the SAIL hardware version register.

child-binding:
  description: |
    SAIL I2C PMIC (TI TPS6594-Q1 class, device ID 0x82 at address 0x28).
    Its children are the nine rails in boot order: LDO0 to LDO3, then
    SMPS0 to SMPS4.

  child-binding:
    description: One PMIC rail and the boot policy for it.

    properties:
      qcom,group:
        type: string
        required: true
        enum:
          - "ldo"
          - "smps"

      qcom,index:
        type: int
        required: true
        description: Rail number within its group.

      qcom,mode:
        type: int
        required: true
        description: Required regulator mode (LDO mode 2, SMPS mode 0).

      regulator-min-microvolt:
        type: int
        required: true

      regulator-max-microvolt:
        type: int
        required: true

      qcom,write-permitted:
        type: boolean
        description: The cold initialization may write the rail's voltage.

      qcom,enable-required:
        type: boolean
        description: The rail must be enabled for SAIL to run.
```

## dts/bindings/clock/qcom,sail-cc.yaml
```yaml
# Copyright The Zephyr Project Contributors
# SPDX-License-Identifier: Apache-2.0

description: |
  Qualcomm safety island (SAIL) clock controller.

  Clock specifiers use the identifiers from
  include/zephyr/dt-bindings/clock/qcom-sail-cc.h.

compatible: "qcom,sail-cc"

include: [clock-controller.yaml, base.yaml]

properties:
  reg:
    required: true

  "#clock-cells":
    const: 1

  pll0-out-main-frequency:
    type: int
    default: 600000000
    description: |
      Rate of the PLL0 main output in Hz, as set up by the cold boot. Used as
      the second clock source of the serial engine root clocks; the XO is
      tried first.

clock-cells:
  - id
```

## dts/bindings/mbox/qcom,sail-mbox-rx.yaml
```yaml
# Copyright The Zephyr Project Contributors
# SPDX-License-Identifier: Apache-2.0

description: |
  Qualcomm Monaco SAIL main-domain doorbell receiver. The SAIL receives two
  edge-triggered doorbell interrupts from the main domain, one non-secure and
  one secure. Each doorbell carries four status bytes in the register window,
  held in the low byte of four consecutive 32-bit status registers that both
  doorbells share. The bytes form a little-endian 32-bit message.

compatible: "qcom,sail-mbox-rx"

include: [base.yaml, mailbox-controller.yaml]

properties:
  reg:
    required: true
    description: Four consecutive 32-bit status registers.

  interrupts:
    required: true

  interrupt-names:
    required: true
    enum: ["nonsecure", "secure"]
    description: Non-secure doorbell, then secure doorbell.

  "#mbox-cells":
    const: 1

mbox-cells:
  - channel
```

## dts/bindings/misc/qcom,geni-se-qup.yaml
```yaml
# Copyright The Zephyr Project Contributors
# SPDX-License-Identifier: Apache-2.0

description: |
  Qualcomm QUP wrapper holding GENI serial engines. The reg property is the
  wrapper common register block; the clocks are the wrapper clocks that
  every serial engine needs.

compatible: "qcom,geni-se-qup"

include: base.yaml

properties:
  reg:
    required: true

  clocks:
    required: true
```

## dts/bindings/pinctrl/qcom,sail-tlmm.yaml
```yaml
# Copyright The Zephyr Project Contributors
# SPDX-License-Identifier: Apache-2.0

description: |
  Qualcomm safety island (SAIL) top-level mode multiplexer (TLMM).

  Each child node configures one SAIL pad. The pinmux property holds the
  pad number and the function select:

    &tlmm {
            se2_uart_tx: se2_uart_tx {
                    pinmux = <6 1>;
                    drive-strength = <4>;
                    bias-disable;
            };
    };

compatible: "qcom,sail-tlmm"

include: base.yaml

properties:
  reg:
    required: true

child-binding:
  description: SAIL pad configuration.

  include:
    - name: pincfg-node.yaml
      property-allowlist:
        - bias-disable
        - bias-pull-down
        - bias-pull-up
        - drive-strength

  properties:
    pinmux:
      required: true
      type: array
      description: Pad number and function select.

    drive-strength:
      enum: [2, 4, 6, 8, 10, 12, 14, 16]
      default: 2
      description: Output drive strength in mA.
```

## dts/bindings/serial/qcom,geni-uart.yaml
```yaml
# Copyright The Zephyr Project Contributors
# SPDX-License-Identifier: Apache-2.0

description: |
  Qualcomm GENI serial engine in UART mode. The node is a child of a
  qcom,geni-se-qup wrapper node, whose clocks are enabled with it.

compatible: "qcom,geni-uart"

include: [uart-controller.yaml, pinctrl-device.yaml]

properties:
  reg:
    required: true

  clocks:
    required: true
    description: Serial engine clock.

  clock-frequency:
    type: int
    default: 7372800
    description: Serial engine clock rate in Hz requested from the clock controller.

  current-speed:
    required: true

  pinctrl-0:
    required: true

  pinctrl-names:
    required: true
```

## soc/qcom/Kconfig
```kconfig
# Copyright The Zephyr Project Contributors
# SPDX-License-Identifier: Apache-2.0

if SOC_FAMILY_QUALCOMM

rsource "*/Kconfig"

endif
```

## soc/qcom/Kconfig.soc
```kconfig
# Copyright The Zephyr Project Contributors
# SPDX-License-Identifier: Apache-2.0

config SOC_FAMILY_QUALCOMM
	bool

config SOC_FAMILY
	default "qualcomm" if SOC_FAMILY_QUALCOMM

rsource "*/Kconfig.soc"
```

## soc/qcom/sail/Kconfig
```kconfig
# Copyright The Zephyr Project Contributors
# SPDX-License-Identifier: Apache-2.0

config SOC_SERIES_SAIL
	select ARM
	select CPU_CORTEX_R52
	select CPU_HAS_ARM_MPU
	select CPU_HAS_MPU
	select GIC_SINGLE_SECURITY_STATE
	select SOC_EARLY_INIT_HOOK if !SAIL_SECONDARY_CLUSTER

config SOC_SAIL_LEMANS
	help
	  Qualcomm Lemans safety island with Cortex-R52 processors.

config SOC_SAIL_MONACO
	help
	  Qualcomm Monaco safety island with Cortex-R52 processors.

config SAIL_ENTRY_ADDRESS
	hex
	depends on SOC_SERIES_SAIL
	default $(dt_chosen_reg_addr_hex,$(DT_CHOSEN_Z_SRAM))
	help
	  Image entry vector, at the start of the image SRAM. The boot ROM and
	  the core release both start cores here.

config SAIL_START_WITHOUT_PCINIT
	bool "Start applications with PCInit deferred"
	depends on SOC_SERIES_SAIL
	select EXPERIMENTAL
	help
	  The cold initialization sequence stops before the power sequencer
	  programs are installed (PCInit), which is not implemented. Select
	  this to start applications at that point; sail_boot_mode_get() then
	  returns SAIL_BOOT_PCINIT_DEFERRED. Without it, and after any other
	  initialization failure, the boot stops before applications start.

config SAIL_MD_RECEIVE
	bool "Main-domain message queue"
	depends on SOC_SERIES_SAIL && MBOX
	help
	  Queue the messages the main domain sends through the SAIL receive
	  mailbox so that a thread can handle them. The application starts
	  reception and must be the only user of both channels. The mailbox
	  callback and the API serialize on a spinlock in the receiver.

config SAIL_RESET_SERVICE
	bool "Main-domain reset coordinator"
	depends on SAIL_START_WITHOUT_PCINIT && SAIL_MD_RECEIVE
	depends on MBOX_QCOM_SAIL_RX && !USERSPACE
	depends on !SMP || SCHED_CPU_MASK
	select EXPERIMENTAL
	help
	  Answer the main domain's reset (SOC_HR) and shutdown notices. For a
	  reset, prepare the reset controls and the PMIC, wait 50 ms and send
	  the answer word. For a shutdown the PMIC is prepared for power-off
	  instead, without the delay. The application starts the coordinator,
	  polls it from one thread and supplies a callback that retires its
	  own resources first. Under SMP that thread must be pinned to CPU 0
	  before it starts. On a board without a SAIL PMIC both notices are
	  answered at once, after clearing any armed reset debug enables;
	  the main domain's PS_HOLD then acts through the main PMIC.

config SAIL_SECONDARY_CLUSTER
	bool "Image for processor cluster 1"
	depends on SOC_SERIES_SAIL && SMP
	help
	  Build an image for cluster 1, which has its own interrupt controller
	  and runs next to the cluster-0 image. It has no cold initialization
	  and no main-domain services. The cluster-0 image starts its first
	  core; it starts its second core when the fuses allow it.

config SAIL_SECONDARY_CLUSTER_ENTRY
	hex "Cluster-1 image entry address"
	depends on SOC_SERIES_SAIL && SMP && !SAIL_SECONDARY_CLUSTER
	default 0x0
	help
	  Entry of the cluster-1 image loaded with this image. When not zero
	  and an entry vector is found there, the kernel starts cluster 1 at
	  this address after the cold initialization. Zero leaves cluster 1
	  in reset.
```
