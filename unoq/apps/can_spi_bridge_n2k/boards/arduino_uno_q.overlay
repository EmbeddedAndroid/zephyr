/*
 * NMEA 2000 CAN<->SPI bridge overlay for the Arduino UNO Q (STM32U585).
 *
 * NMEA 2000 is CLASSIC CAN 2.0B at 250 kbit/s with 29-bit extended IDs --
 * NOT CAN FD. So this overlay configures only the single (arbitration) bitrate
 * at 250000 and omits the FD data-phase properties entirely. The firmware runs
 * the controller in classic mode (no CAN_MODE_FD) and tags frames as extended.
 *
 *  - FDCAN1 @ 250 kbit/s classic (kernel clock PLL1_Q, pins PD0/PD1).
 *  - SPI3 as SPI slave (board-default pins), QCM /dev/spidev0.0 master.
 *
 * For a REAL N2K bus a CAN transceiver must be wired to PD0(RX)/PD1(TX) and the
 * firmware built in normal (non-loopback) mode -- see the BENCH_LOOPBACK switch
 * in src/main.c. As shipped it is loopback for bench/bringup without hardware.
 */

/ {
	chosen {
		zephyr,canbus = &fdcan1;
	};

	zephyr,user {
		rdy-gpios = <&gpiog 13 GPIO_ACTIVE_HIGH>;
	};
};

&fdcan1 {
	clocks = <&rcc STM32_CLOCK(APB1_2, 9)>,
		 <&rcc STM32_SRC_PLL1_Q FDCAN1_SEL(1)>;
	pinctrl-0 = <&fdcan1_rx_pd0 &fdcan1_tx_pd1>;
	pinctrl-names = "default";
	/* NMEA 2000: classic CAN, 250 kbit/s, sample point 87.5%. No FD/BRS. */
	bitrate = <250000>;
	sample-point = <875>;
	status = "okay";
};
